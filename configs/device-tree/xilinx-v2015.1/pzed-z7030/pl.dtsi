/*
 * CAUTION: This file is automatically generated by Xilinx.
 * Version:  
 * Today is: Sun May 17 21:16:03 2015
*/


/ {
	amba_pl: amba_pl {
		#address-cells = <1>;
		#size-cells = <1>;
		compatible = "simple-bus";
		ranges ;
		panda_pcap_0: panda_pcap@43c10000 {
			compatible = "xlnx,panda-pcap-1.0";
			interrupt-parent = <&intc>;
			interrupts = <0 29 1>;
			reg = <0x43c10000 0x10000>;
			xlnx,s00-axi-addr-width = <0x7>;
			xlnx,s00-axi-data-width = <0x20>;
		};
	};
};
