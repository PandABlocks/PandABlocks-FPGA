/dts-v1/;
/include/ "system-top.dts.tmp"

&sdhci1 {
	disable-wp;
	no-1-8-v;
};

/ {
	amba_pl: amba_pl {
		#address-cells = <1>;
		#size-cells = <1>;
		compatible = "simple-bus";
		ranges ;
		panda_pcap_0: panda_pcap@a0000000 {
			compatible = "xlnx,panda-pcap-1.0";
			reg = <0xa0000000 0x20000>;
			interrupt-parent = <&gic>;
			interrupts = <0 89 1>;
		};
	};
};
